/dts-v1/;
/plugin/;

/ {
        compatible = "allwinner,sun8i-h3";

        fragment@1 {
                target = <&spi0>;
                __overlay__ {
                        /* needed to avoid dtc warning */
                        #address-cells = <1>;
                        #size-cells = <0>;
                        status = "okay";
                        ili9488: ili9488@0{
                                status = "okay";
                                compatible = "ilitek,ili9488";
                                        reg = <0>;
                                        spi-max-frequency = <40000000>;
                                        rotate = <270>;
                                        spi-cpol;
                                        spi-cpha;
                                        bgr;
                                        fps = <60>;
                                        buswidth = <8>;
                                        dc-gpios = <&pio 6 7 0>; /* PG7 */
                                        reset-gpios = <&pio 6 6 1>; /* PG6 */
                                        debug = <0>;
                        };
                };
        };
};
